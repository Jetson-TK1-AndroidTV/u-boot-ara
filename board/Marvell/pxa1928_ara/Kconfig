## board/Marvell/pxa1928_ara/Kconfig
```kconfig
if TARGET_PXA1928ARA

config SYS_CPU
	string
	default "armv8"

config SYS_BOARD
	string
	default "pxa1928_ara"

config SYS_VENDOR
	string
	default "Marvell"

config SYS_SOC
	string
	default "pxa1928"

config SYS_CONFIG_NAME
	string
	default "pxa1928_ara"

endif
```
